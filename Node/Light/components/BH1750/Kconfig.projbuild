## Node/Light/components/BH1750/Kconfig.projbuild
```kconfig
menu "BH1750 Configuration"
    config I2C_BH1750_SCL_IO
        int "I2C SCL IO number"
        default 34
        help
            I2C SCL port number.
    config I2C_BH1750_SDA_IO
        int "I2C SDA IO number"
        default 33
        help
            I2C SDA port number.
    config I2C_BH1750_NUM
        int "I2C port number"
        default 1
        help
            I2C port number; I2C_NUM_i=i.
    config I2C_BH1750_FREQ
        int "I2C frequency"
        default 100000
        help
            I2C frequency.
endmenu
```

## Node/Light/components/LED_matrix/Kconfig.projbuild
```kconfig
menu "LED matrix Configuration"

    config MATRIX_GPIO
        int "Blink GPIO number"
        range 0 48
        default 18
        help
            GPIO number (IOxx) to data pin of the LED matrix
    config MATRIX_LED_NUMBERS
        int "Blink LED number"
        default 64
        help
            Numbers of the LED in the strip
    config MATRIX_RESOLUTION
        int "LED matrix rmt resolution"
        default 10000000
        help
            LED matrix rmt resolution.
    config MATRIX_BRIGHTNESS_RED
        int "LED matrix brightness in red"
        range 0 255
        default 0
        help
             LED matrix brightness in red.
    config MATRIX_BRIGHTNESS_GREEN
        int "LED matrix brightness in green"
        range 0 255
        default 0
        help
             LED matrix brightness in green.
    config MATRIX_BRIGHTNESS_BLUE
        int "LED matrix brightness in blue"
        range 0 255
        default 0
        help
             LED matrix brightness in blue.
endmenu
```

## Node/Soil_Relay/components/button/Kconfig.projbuild
```kconfig
menu "Button Configuration"

    orsource "$IDF_PATH/examples/common_components/env_caps/$IDF_TARGET/Kconfig.env_caps"

    config GPIO_BUTTON
        int "GPIO button pin"
        default 0
        help
            GPIO button pin, don't set target for different boards.

endmenu
```

## Node/Soil_Relay/components/mesh_blufi/Kconfig.projbuild
```kconfig
menu "Blufi Configuration"

    config EXAMPLE_WIFI_CONNECTION_MAXIMUM_RETRY
        int "WiFi connection maximum retry"
        range 0 255
        default 2
        help
            WiFi connection maximum retry, from 0 to 255.
    
    choice
        bool "Protocal to be used"
        default BT_NIMBLE_ENABLED
        help
            Protocal to be used.

        config BT_NIMBLE_ENABLED
            bool "NIMBLE"
        config BT_BLUEDROID_ENABLED
            bool "BLUEDROID"
    endchoice

    config DEVICE_NAME
        string "Device name"
        default "ESP32"
        help
            Device name.
endmenu
```

## Node/Soil_Relay/main/Kconfig.projbuild
```kconfig
menu "Example Configuration"

    orsource "$IDF_PATH/examples/common_components/env_caps/$IDF_TARGET/Kconfig.env_caps"

    config GPIO_OUTPUT_0
        int "GPIO output pin 0"
        range ENV_GPIO_RANGE_MIN ENV_GPIO_OUT_RANGE_MAX
        default 8 if IDF_TARGET_ESP32C2 || IDF_TARGET_ESP32H2
        default 18
        help
            GPIO pin number to be used as GPIO_OUTPUT_IO_0.


endmenu
```

## Node/Temp_Humi/components/HTS221/Kconfig.projbuild
```kconfig
menu "HTS221 Configuration"
    config I2C_HTS221_SCL_IO
        int "I2C SCL port number"
        default 26
        help
            I2C SCL port number.
    config I2C_HTS221_SDA_IO
        int "I2C SDA port number"
        default 21
        help
            I2C SDA port number.
    config I2C_HTS221_NUM
        int "I2C port number"
        default 0
        help
            I2C port number; I2C_NUM_i=i.
    config I2C_HTS221_FREQ
        int "I2C frequency"
        default 100000
        help
            I2C frequency.
endmenu
```

## Router/Root_for_mesh/components/mesh_blufi/Kconfig.projbuild
```kconfig
menu "Blufi Configuration"

    config EXAMPLE_WIFI_CONNECTION_MAXIMUM_RETRY
        int "WiFi connection maximum retry"
        range 0 255
        default 2
        help
            WiFi connection maximum retry, from 0 to 255.

    config DEVICE_NAME
        string "Device name"
        default "ESP32"
        help
            Device name.
endmenu
```

## Router/components/mesh_network/Kconfig.projbuild
```kconfig
menu "Mesh Basic Configuration"

    choice
        bool "Device type"
        default MESH_SET_ROOT
        help
            Device type (root or node).

        config MESH_SET_ROOT
            bool "MESH_SET_ROOT"
        config MESH_SET_NODE
            bool "MESH_SET_NODE"
    endchoice
    
    choice
        bool "Mesh Node Function"
        default LED
        help
            Mesh Node Function.

        config LED
            bool "LED"
        config Relay
            bool "Relay"
        config Humidity
            bool "HTS221 Humidity Sensor"
        config Light
            bool "BH1750 Light Sensor"
        config Temperature
            bool "Temperature Sensor"
        config Soil
            bool "Soil moisture sensor"
    endchoice

    config MESH_NODE_FUNCTION_INDEX
        int
        default 0 if LED
        default 1 if Relay
        default 2 if Humidity
        default 3 if Light
        default 4 if Temperature
        default 5 if Soil
        default 6 if MESH_SET_ROOT
        help
            Mesh Node function index
    
    config MESH_CHANNEL
        int "channel"
        range 0 14
        default 0
        help
            mesh network channel.

    config MESH_ROUTER_SSID
        string "Router SSID"
        default "SZMiPhone"
        help
            Router SSID.

    config MESH_ROUTER_PASSWD
        string "Router password"
        default "1029384756"
        help
            Router password.

    choice
        bool "Mesh AP Authentication Mode"
        default WIFI_AUTH_WPA2_PSK
        help
            Authentication mode.

        config WIFI_AUTH_OPEN
            bool "WIFI_AUTH_OPEN"
        config WIFI_AUTH_WPA_PSK
            bool "WIFI_AUTH_WPA_PSK"
        config WIFI_AUTH_WPA2_PSK
            bool "WIFI_AUTH_WPA2_PSK"
        config WIFI_AUTH_WPA_WPA2_PSK
            bool "WIFI_AUTH_WPA_WPA2_PSK"
    endchoice

    config MESH_AP_AUTHMODE
        int
        default 0 if WIFI_AUTH_OPEN
        default 2 if WIFI_AUTH_WPA_PSK
        default 3 if WIFI_AUTH_WPA2_PSK
        default 4 if WIFI_AUTH_WPA_WPA2_PSK
        help
            Mesh AP authentication mode.

    config MESH_AP_PASSWD
        string "Mesh AP Password"
        default "MAP_PASSWD"
        help
            Mesh AP password.

    config MESH_AP_CONNECTIONS
        int "Mesh AP Connections"
        range 1 10
        default 6
        help
            The number of mesh stations allowed to connect in.

    config MESH_NON_MESH_AP_CONNECTIONS
        int "Mesh Non Mesh AP Connections"
        range 0 9
        default 0
        help
            The number of non-mesh stations allowed to connect in.

    config MESH_MAX_LAYER
        int "Mesh Max Layer"
        range 1 25
        default 6
        help
            Max layer allowed in mesh network.

    config MESH_ROUTE_TABLE_SIZE
        int "Mesh Routing Table Size"
        range 1 300
        default 50
        help
            The number of devices over the network(max: 300).

    config MESH_IE_CRYPTO_KEY
        string "Mesh IE Crypto Key"
        default "hello, esp-mesh."
        help
            Mesh IE ASCII crypto key, length in bytes, range:8~64.

    choice
        bool "Mesh IE Crypto Funcs"
        default IE_CRYPTO_ENABLE
        help
            Mesh IE crypto funcs.

        config IE_CRYPTO_ENABLE
            bool "IE_CRYPTO_ENABLE"
        config IE_CRYPTO_DISABLE
            bool "IE_CRYPTO_DISABLE"
    endchoice

    config MESH_IE_CRYPTO_FUNCS
        int
        default 1 if IE_CRYPTO_ENABLE
        default 0 if IE_CRYPTO_DISABLE
        help
             Mesh IE crypto enable/disable.
endmenu
```
